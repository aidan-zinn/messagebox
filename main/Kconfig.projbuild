## main/Kconfig.projbuild
```kconfig
menu "Messagebox Configuration"

    config WIFI_SSID
        string "WiFi SSID"
        default "myssid"

    config WIFI_PASSWORD
        string "WiFi Password"
        default "mypassword"

    config MQTT_BROKER_URI
        string "MQTT Broker URI"
        default "mqtt://broker.hivemq.com"

    config MQTT_TOPIC
        string "MQTT Topic"
        default "lovebox/message"

endmenu
```

## main/Kconfig.projbuild.template
```kconfig
menu "Messagebox Configuration"

    config WIFI_SSID
        string "WiFi SSID"
        default "YOUR_WIFI_SSID"

    config WIFI_PASSWORD
        string "WiFi Password"
        default "YOUR_WIFI_PASSWORD"

    config MQTT_BROKER_URI
        string "MQTT Broker URI"
        default "mqtts://YOUR_CLUSTER.hivemq.cloud:8883"

    config MQTT_USERNAME
        string "MQTT Username"
        default "messagebox"

    config MQTT_PASSWORD
        string "MQTT Password"
        default "YOUR_MQTT_PASSWORD"

    config MQTT_TOPIC
        string "MQTT Topic"
        default "messagebox/message"

endmenu
```

## sdkconfig.defaults
```kconfig
CONFIG_IDF_TARGET="esp32c3"
CONFIG_ESPTOOLPY_FLASHSIZE_4MB=y
CONFIG_LOG_DEFAULT_LEVEL_INFO=y
CONFIG_LOG_DEFAULT_LEVEL=3
CONFIG_ESP_WIFI_ENABLE_WPA3_SAE=y
```
